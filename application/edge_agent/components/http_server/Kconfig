## application/edge_agent/components/http_server/Kconfig
```kconfig
menu "HTTP Server"

    config HTTP_SERVER_LUA_MODULES_API
        bool "Lua module listing API"
        default y
        help
            Serve GET /api/lua-modules, which the portal uses to list the Lua
            modules compiled into this build.

            This is the only part of the server that reads the module list
            straight out of app_claw, so turning it off drops that dependency
            and lets the server be built without the capability framework. The
            dependency itself is declared in idf_component.yml, because a
            condition on this symbol inside CMakeLists does not take effect.

endmenu
```

## components/openclaw_node/Kconfig
```kconfig
menu "OpenClaw Native Node"

    config OPENCLAW_NODE_DEVICE_COMMANDS
        bool "Built-in board device commands"
        default y
        help
            Build the device command table that node.invoke.request dispatches
            to: screen, audio, backlight, button, file and Lua commands. It needs
            the board manager, the system UI and the capability framework.

            Disable this to build the transport on its own. The component's own
            on-target tests do that, so they can run without a board, a display
            or the audio stack. openclaw_node_device_commands() then reports an
            empty command list and every command answers ESP_ERR_NOT_SUPPORTED.

endmenu
```
